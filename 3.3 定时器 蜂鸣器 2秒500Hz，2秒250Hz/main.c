/*-----------------------------------------------
  名称：蜂鸣器
  编写：hongXkeX
  日期：2016.11.17
  修改：无
  内容：蜂鸣器 2s 500Hz 2s 250Hz 如此循环
------------------------------------------------*/

#include "main.h"

u8 k = 0;		
sbit bz = P1^5;

/*------------------------------------------------
                    主程序
------------------------------------------------*/
void main()
{
	init();
	t0_init();
	EA = 1;         //总中断打开
	while(1) 
	{
		if(k<=40) {
			bz = ~bz;
			delay1ms();		//发出大约500Hz的方波 频率越大声音越尖
		}else if(k<=80) {
			bz = ~bz;
			delay2ms();		//发出大约250Hz的方波 频率越大声音越尖
			if(k==80) k=0;	
		}
		
	}		
}

/*------------------------------------------------
             单片机初始化子程序
------------------------------------------------*/
void init()
{
	
}

/*------------------------------------------------
              定时器0初始化子程序
------------------------------------------------*/
void t0_init()
{
	TMOD &= (0xf0);            
	TMOD |= (0x01);     //使用模式1，16位定时器

	TH0 = (65536-250)/256;
	TL0 = (65536-250)%256;
	
	ET0 = 1;     //定时器中断打开
	TR0 = 1;     //定时器开关打开
}

/*------------------------------------------------
                定时器0中断子程序
------------------------------------------------*/
void t0_isr() interrupt 1
{
	TH0 = (65536-50000)/256;    
	TL0 = (65536-50000)%256;   
    k++;
}
